// Controller Code
#include <esp_now.h>
#include <WiFi.h>
#define RESEND_COUNT 3
#define A1 {0x24, 0x0A, 0xC4, 0x12, 0x34, 0x56}
#define A2 {0x24, 0x0A, 0xC4, 0x78, 0x9A, 0xBC}
#define A3 {0x24, 0x0A, 0xC4, 0xDE, 0xF0, 0x12}
#define A4 {0x24, 0x0A, 0xC4, 0x34, 0x56, 0x78}
#define A5 {0x24, 0x0A, 0xC4, 0x9A, 0xBC, 0xDE}
#define A6 {0x24, 0x0A, 0xC4, 0xF0, 0x12, 0x34}
#define B1 {0x24, 0x0A, 0xC4, 0x56, 0x78, 0x9A}
#define B2 {0x24, 0x0A, 0xC4, 0xBC, 0xDE, 0xF0}
#define B3 {0x24, 0x0A, 0xC4, 0x12, 0x34, 0x56}
#define B4 {0x24, 0x0A, 0xC4, 0x78, 0x9A, 0xBC}
#define B5 {0x24, 0x0A, 0xC4, 0xDE, 0xF0, 0x12}
#define B6 {0x24, 0x0A, 0xC4, 0x34, 0x56, 0x78}
#define C1 {0x24, 0x0A, 0xC4, 0x9A, 0xBC, 0xDE}
#define C2 {0x24, 0x0A, 0xC4, 0xF0, 0x12, 0x34}
#define C3 {0x24, 0x0A, 0xC4, 0x56, 0x78, 0x9A}
#define C4 {0x24, 0x0A, 0xC4, 0xBC, 0xDE, 0xF0}
#define C5 {0x24, 0x0A, 0xC4, 0x12, 0x34, 0x56}
#define C6 {0x24, 0x0A, 0xC4, 0x78, 0x9A, 0xBC}
#define D1 {0x24, 0x0A, 0xC4, 0xDE, 0xF0, 0x12}
#define D2 {0x24, 0x0A, 0xC4, 0x34, 0x56, 0x78}
#define D3 {0x24, 0x0A, 0xC4, 0x9A, 0xBC, 0xDE}
#define D4 {0x24, 0x0A, 0xC4, 0xF0, 0x12, 0x34}
#define D5 {0x24, 0x0A, 0xC4, 0x56, 0x78, 0x9A}
#define D6 {0x24, 0x0A, 0xC4, 0xBC, 0xDE, 0xF0}
#define E1 {0x24, 0x0A, 0xC4, 0x12, 0x34, 0x56}
#define E2 {0x24, 0x0A, 0xC4, 0x78, 0x9A, 0xBC}
#define E3 {0x24, 0x0A, 0xC4, 0xDE, 0xF0, 0x12}
#define E4 {0x24, 0x0A, 0xC4, 0x34, 0x56, 0x78}
#define E5 {0x24, 0x0A, 0xC4, 0x9A, 0xBC, 0xDE}
#define F1 {0x24, 0x0A, 0xC4, 0xF0, 0x12, 0x34}
#define F2 {0x24, 0x0A, 0xC4, 0x56, 0x78, 0x9A}
#define F3 {0x24, 0x0A, 0xC4, 0xBC, 0xDE, 0xF0}
#define F4 {0x24, 0x0A, 0xC4, 0x12, 0x34, 0x56}
#define F5 {0x24, 0x0A, 0xC4, 0x78, 0x9A, 0xBC}
#define F6 {0x24, 0x0A, 0xC4, 0xDE, 0xF0, 0x12}

uint8_t broadcastAddr[] = {0xFF, 0xFF,0xFF,0xFF,0xFF,0xFF};
uint8_t test1Addr[] =     {0x1};
uint8_t test2Addr[] =     {0x1};

// Ringlight MAC Addresses
uint8_t ringLightAddresses[][6] = {
  {0x30, 0xAE, 0xA4, 0x45, 0x6F, 0x9B}, // Ringlight 1
  {0x3C, 0x61, 0x05, 0x1A, 0x0B, 0xB5}, // Ringlight 2
  //A1, A2, A3, A4, A5, A6,   Add more ringlight addresses here
  //B1, B2, B3, B4, B5, B6,
  //C1, C2, C3, C4, C5, C6,
  //D1, D2, D3, D4, D5, D6,
  //E1, E2, E3, E4, E5,
  //F1, F2, F3, F4, F5, F6
};

// Packet Structure
typedef struct {
  uint8_t addresses[20][6]; // Max 20 addresses per packet 
  uint8_t colors[20][3];    // RGB color values
  uint8_t count;            // Number of devices in this packet
} RCPData;

RCPData data;

void sendRCPPacket() { 
  for (uint8_t i = 0; i < RESEND_COUNT; i++) {
    esp_now_send(broadcastAddr, (uint8_t*)&data, sizeof(data)); // broadcastAddr instead of NULL; NULL sends to all registered peers, of which we have none
    delay(10); // Add a small delay between resends
  }
}

void loadRCPPacket(uint8_t* macAddrToAdd, uint8_t r, uint8_t g, uint8_t b) {
  // Add the MAC address and color to the data struct
  for(uint8_t i = 0; i < 6; i++) {// ... (mac addresses are 6 bytes long)
    data.addresses[data.count][i] = macAddrToAdd[i];
  }
  data.colors[data.count][0] = r;
  data.colors[data.count][1] = g;
  data.colors[data.count][2] = b;
  data.count++;

  // If we've reached 20 devices, send the packet
  if (data.count == 20) {
    sendRCPPacket();
    data.count = 0; // Reset count
  }
}

void setColor(uint8_t r, uint8_t g, uint8_t b) {// sets all ringlights the same color.
  // Iterate through all 40 ringlights and call loadRCPPacket
  // Example:
  for(uint8_t i = 0; i < 40; i++) {
    loadRCPPacket(ringLightAddresses[i], r, g, b);  
  }
}

void setup() {
  Serial.begin(115200);
  WiFi.mode(WIFI_STA);
  if (esp_now_init() != ESP_OK) {
    Serial.println("Error initializing ESP-NOW");
    return;
  }
  setColor(123,241,111);
}

void loop() {
  // Handle any other logic here
}
